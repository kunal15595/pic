/*
***************************************************************************************************
[File]			: Config_UART.h
[Processor]     : PIC24F Baud rate calculation equation used.
[Compiler]      : MPLAB C30
[Description]   : UART related Macros and function deffinitions.        
--------------------------------------------------------------------------------------------------- 	
[VERSION]	[DATE]   	[AUTHOR] 							CHANGES
 v1.0	   	10.03.2011 	shashi.prakash@brigosha.com			Origin
 v2.0		07.10.2011	shashi.prakash@brigosha.com			Modified for new coding standards
***************************************************************************************************
 */ 

/*** Include Micorocontroller header files ***/
#include "p24fxxxx.h"
#include "p24FJ256GB206.h"
#include "pic24f_periph_features.h"
#include "timer.h"
#include "uart.h"
#include "ports.h"
#include "Define.h"


 U8 V_SwIntFlag_U8;
 
 U8 A_Rx1Data_U8[32]; 
 U16 V_Rx1DataTime_U16;
 U8 V_Rx1NoOfBytes_U8;

 U16 V_TimeInMsec_U16;
 U16 V_SampleTimeMsec_U16;
 U8  V_SampleTimeFlag_U8;
 
/*
--------------------------------------------------------------------------------------------------- 
[NAME]  	 : _CNInterrupt
[TYPE]		 : Interrupt service routine
[INPUT] 	 : None
[RETURN]	 : None
[DESCRIPTION]: This function interrupts when the switches SW4-6 are pressed or INT1-3 state is changed.
			   The switch interrupt flag is set true. this can be checked to verify for switch press or logical int.
--------------------------------------------------------------------------------------------------- 
*/
void __attribute__((interrupt,no_auto_psv)) _CNInterrupt(void)
{
	V_SwIntFlag_U8 = C_TRUE;
	InputChange_Clear_Intr_Status_Bit; 
	
}

/*
--------------------------------------------------------------------------------------------------- 
[NAME]  	 : _U1RXInterrupt
[TYPE]		 : Interrupt service routine
[INPUT] 	 : None
[RETURN]	 : None
[DESCRIPTION]: This function interrupts when data is being recived in UART1, it stores the data in 
			   a buffer and sets the data flag true.
--------------------------------------------------------------------------------------------------- 
*/
void __attribute__ ((interrupt,no_auto_psv)) _U1RXInterrupt(void)
{   
   	U1RX_Clear_Intr_Status_Bit;
   	while((!DataRdyUART1()) || (!U1STAbits.RIDLE));
   	A_Rx1Data_U8[V_Rx1NoOfBytes_U8++] = ReadUART1();
   	if(V_Rx1NoOfBytes_U8>31)
	{
		V_Rx1NoOfBytes_U8=0;
	}
	V_Rx1DataTime_U16 = V_TimeInMsec_U16;
}   


/*
--------------------------------------------------------------------------------------------------- 
[NAME]  	 : _U2RXInterrupt
[TYPE]		 : Interrupt service routine
[INPUT] 	 : None
[RETURN]	 : None
[DESCRIPTION]: This function interrupts when data is being recived in UART2, it stores the data in 
			   a buffer and sets the data flag true.
--------------------------------------------------------------------------------------------------- 
*/
void __attribute__ ((interrupt, no_auto_psv)) _U2RXInterrupt(void) 
{
	U2RX_Clear_Intr_Status_Bit;
   	while((!DataRdyUART2()) || (!U2STAbits.RIDLE));
   	A_Rx1Data_U8[V_Rx1NoOfBytes_U8++] = ReadUART2();
   	if(V_Rx1NoOfBytes_U8>31)
	{
		V_Rx1NoOfBytes_U8=0;
	}
	V_Rx1DataTime_U16 = V_TimeInMsec_U16;
}


/*
--------------------------------------------------------------------------------------------------- 
[NAME]  	 : _T2Interrupt
[TYPE]		 : Interrupt service routine
[INPUT] 	 : None
[RETURN]	 : None
[DESCRIPTION]: This function Interrupts when the timer compare/Tick value has elapsed. Any multiple of 1 mSec
			   timer can be generated by specifying the value in SampleTime variable.
--------------------------------------------------------------------------------------------------- 
*/
void __attribute__ ((interrupt,no_auto_psv)) _T2Interrupt(void)
{ 	
 	T2_Clear_Intr_Status_Bit;
 	V_TimeInMsec_U16++;
 	if(V_TimeInMsec_U16 == V_SampleTimeMsec_U16)
 	{
	 	V_TimeInMsec_U16 = 0;
	 	V_SampleTimeFlag_U8 = C_TRUE;	
 	}	
 
}


